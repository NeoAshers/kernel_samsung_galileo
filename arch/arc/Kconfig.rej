## arch/arm64/configs/tizen_noblesse_chub_defconfig
```kconfig
CONFIG_NOBLESSE_CHUB=y
CONFIG_GNSS_SHMEM_IF=y
CONFIG_CONTEXTHUB_DRV=y
CONFIG_GNSS_PMUCAL=y

CONFIG_SENSORS_SSP_CHUB=y
CONFIG_SENSORS_SYSFS=y
CONFIG_SENSORS_SSP=y
CONFIG_SENSORS_SSP_SENSORHUB=y
CONFIG_SENSORS_SSP_FACTORY=y
CONFIG_SENSORS_SSP_ACCELEROMETER_SENSOR=y
CONFIG_SENSORS_SSP_ACCELEROMETER_32GSENSOR=y
CONFIG_SENSORS_SSP_GYRO_SENSOR=y
CONFIG_SENSORS_SSP_PRESSURE_SENSOR=y
CONFIG_SENSORS_SSP_LIGHT_SENSOR=y
CONFIG_SENSORS_SSP_HRM_SENSOR=y
CONFIG_SENSORS_SSP_LPM_MOTION=y
CONFIG_SENSORS_SSP_LSM6DSL=y
CONFIG_SENSORS_SSP_LPS25H=y
CONFIG_SENSORS_SSP_OPT3007=y
CONFIG_SENSORS_SSP_PPS960=y
CONFIG_SENSORS_ECG_FAC=y
CONFIG_SENSORS_ECG_LIB=y
```

## arch/arm64/configs/tizen_noblesse_large_defconfig
```kconfig
CONFIG_NOBLESSE_LARGE=y
# CONFIG_EXYNOS_DECON_LCD_S6E36W3X01 is not set
# CONFIG_EXYNOS_DECON_LCD_RM69330 is not set
CONFIG_EXYNOS_DECON_LCD_RM69091=y
CONFIG_EXYNOS_DECON_LCD_S6E36W4X01_L=y
# CONFIG_EXYNOS_DECON_LCD_S6E36W4X01_S is not set
# CONFIG_EXYNOS_DECON_LCD_S6E36W4X01_AFPC is not set
```

## arch/arm64/configs/tizen_renaissance_brcm_defconfig
```kconfig
CONFIG_RENAISSANCE_BRCM=y
CONFIG_SENSORS_SSP_BBD=y
CONFIG_SENSORS_SYSFS=y
CONFIG_SENSORS_SSP=y
CONFIG_SENSORS_SSP_SENSORHUB=y
CONFIG_SENSORS_SSP_FACTORY=y
CONFIG_SENSORS_SSP_ACCELEROMETER_SENSOR=y
CONFIG_SENSORS_SSP_GYRO_SENSOR=y
CONFIG_SENSORS_SSP_PRESSURE_SENSOR=y
CONFIG_SENSORS_SSP_LIGHT_SENSOR=y
CONFIG_SENSORS_SSP_HRM_SENSOR=y
CONFIG_SENSORS_SSP_LPM_MOTION=y
CONFIG_SENSORS_SSP_LSM6DSL=y
CONFIG_SENSORS_SSP_LPS25H=y
CONFIG_SENSORS_SSP_TSL2584=y
CONFIG_SENSORS_SSP_PPS960=y
CONFIG_SENSORS_BBD_SPI_PORT=0
CONFIG_INPUT_LPS22HB=y
```

## arch/arm64/configs/tizen_renaissance_large_defconfig
```kconfig
CONFIG_RENAISSANCE_LARGE=y
CONFIG_EXYNOS_DECON_LCD_S6E36W3X01_S=y
# CONFIG_EXYNOS_DECON_LCD_RM69330 is not set
CONFIG_EXYNOS_DECON_LCD_S6E36W4X01_L=y
# CONFIG_EXYNOS_DECON_LCD_S6E36W4X01_S is not set
CONFIG_EXYNOS_DECON_LCD_S6E36W4X01_AFPC=y
```

## arch/arm64/configs/tizen_renaissance_small_defconfig
```kconfig
CONFIG_RENAISSANCE_SMALL=y
# CONFIG_EXYNOS_DECON_LCD_S6E36W3X01_S is not set
CONFIG_EXYNOS_DECON_LCD_RM69330=y
# CONFIG_EXYNOS_DECON_LCD_S6E36W4X01_L is not set
CONFIG_EXYNOS_DECON_LCD_S6E36W4X01_S=y
CONFIG_EXYNOS_DECON_LCD_S6E36W4X01_AFPC=y
```

## drivers/misc/gnss_if/Kconfig
```kconfig
config GNSS_SHMEM_IF
	bool "Samsung Shared memory Interface for GNSS"
	select MCU_IPC
	select SHM_IPC
	default n
	---help---
	  Samsung Shared Memory Interface for GNSS.
```

## drivers/sensorhub/Kconfig
```kconfig
menu "Sensor HUB Drivers"

#
# sensor drivers configuration
#

source "drivers/sensorhub/brcm/Kconfig"
source "drivers/sensorhub/brcm_pulse/Kconfig"
source "drivers/sensorhub/slsi_renaissance/Kconfig"
source "drivers/sensorhub/brcm_noblesse/Kconfig"
source "drivers/sensorhub/slsi_noblesse/Kconfig"
endmenu
```

## drivers/sensors/sx9360/Kconfig
```kconfig
config INPUT_SX9360
	tristate "Semtech SX9360"
	depends on (I2C) && SYSFS
	help
	   This driver support the Semtech SX9360 sensor.
	   To compile this driver as a module, choose M here. The module
	   will be called sx9360.

config INPUT_SX9360_I2C
	bool "Use I2C interface for SX9360"
	depends on INPUT_SX9360
	depends on I2C
	help
	  Use I2C insterface for SX9360 sensor
```

## drivers/usb/gadget/Kconfig.rej
```kconfig
--- drivers/usb/gadget/Kconfig
+++ drivers/usb/gadget/Kconfig
@@ -460,7 +460,6 @@ config USB_CONFIGFS_F_TCM
 choice
 	tristate "USB Gadget Drivers"
 	default USB_ETH
-	optional
 	help
 	  A Linux "Gadget Driver" talks to the USB Peripheral Controller
 	  driver through the abstract "gadget" API.  Some other operating
```
